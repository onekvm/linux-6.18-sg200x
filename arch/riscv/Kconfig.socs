## arch/riscv/Kconfig.socs
```kconfig
menu "SoC selection"

config ARCH_ANDES
	bool "Andes SoCs"
	depends on MMU && !XIP_KERNEL
	select ERRATA_ANDES
	help
	  This enables support for Andes SoC platform hardware.

config ARCH_ESWIN
	bool "ESWIN SoCs"
	help
	  This enables support for ESWIN SoC platform hardware,
	  including the ESWIN EIC7700 SoC.

config ARCH_MICROCHIP_POLARFIRE
	def_bool ARCH_MICROCHIP

config ARCH_MICROCHIP
	bool "Microchip SoCs"
	help
	  This enables support for Microchip SoC platforms.

config ARCH_RENESAS
	bool "Renesas RISC-V SoCs"
	help
	  This enables support for the RISC-V based Renesas SoCs.

config ARCH_SIFIVE
	bool "SiFive SoCs"
	select ERRATA_SIFIVE if !XIP_KERNEL
	help
	  This enables support for SiFive SoC platform hardware.

config ARCH_SOPHGO
	bool "Sophgo SoCs"
	help
	  This enables support for Sophgo SoC platform hardware.

menu "Cvitek platform settings"
	depends on ARCH_SOPHGO

config ION_SIZE_MIB
	int "ION carveout size (MiB)" if ION_CVITEK
	range 22 112
	default 48
	help
	  Size of the physically contiguous multimedia carveout used by the
	  video pipeline. The device-tree build calculates a safe base address
	  automatically and rejects layouts which overlap the kernel/FIT load
	  area, U-Boot's runtime/FIT window, or the C906L reservation.

	  The default is 48 MiB. Larger video modes may require increasing this;
	  the NanoKVM SG2002 configuration uses 64 MiB.

config RTOS_RAM_SIZE_MIB
	int "C906L RTOS RAM size (MiB)"
	range 1 16
	default 2
	help
	  Size of the top-of-DRAM region reserved for the C906L firmware and
	  its Linux IPC windows. The device-tree build derives the C906L base
	  address and Linux-visible memory size from this value.

	  The C906L firmware and FSBL memory map must be built with the same
	  value. The default is 2 MiB.

config FRAMEBUFFER_RESERVE
	bool "Reserve framebuffer memory"
	help
	  Reserve a physically contiguous framebuffer region and enable the
	  Cvitek framebuffer device-tree nodes. Disable this on boards without
	  a display output so Linux can use the memory.

config FRAMEBUFFER_SIZE_MIB
	int "Framebuffer size (MiB)"
	depends on FRAMEBUFFER_RESERVE
	range 1 32
	default 8
	help
	  Size of the physically contiguous framebuffer reservation. The
	  device-tree build places it in a safe arena which does not overlap
	  ION, U-Boot/FIT, or C906L memory.

config GPIO_I2C_DELAY_US
	int "GPIO bit-banged I2C delay (us)"
	range 1 100
	default 5
	help
	  Delay between GPIO transitions on the bit-banged I2C bus. A lower
	  value increases the bus frequency. The default is 5 microseconds.

endmenu

config ARCH_SPACEMIT
	bool "SpacemiT SoCs"
	select PINCTRL
	help
	  This enables support for SpacemiT SoC platform hardware.

config ARCH_STARFIVE
	def_bool SOC_STARFIVE

config SOC_STARFIVE
	bool "StarFive SoCs"
	select PINCTRL
	select RESET_CONTROLLER
	select ARM_AMBA
	help
	  This enables support for StarFive SoC platform hardware.

config ARCH_SUNXI
	bool "Allwinner sun20i SoCs"
	depends on MMU && !XIP_KERNEL
	select ERRATA_THEAD
	select SUN4I_TIMER
	help
	  This enables support for Allwinner sun20i platform hardware,
	  including boards based on the D1 and D1s SoCs.

config ARCH_THEAD
	bool "T-HEAD RISC-V SoCs"
	depends on MMU && !XIP_KERNEL
	select ERRATA_THEAD
	select PM_GENERIC_DOMAINS if PM
	help
	  This enables support for the RISC-V based T-HEAD SoCs.

config ARCH_VIRT
	bool "QEMU Virt Machine"
	select POWER_RESET
	select POWER_RESET_SYSCON
	select POWER_RESET_SYSCON_POWEROFF
	select GOLDFISH
	select RTC_DRV_GOLDFISH if RTC_CLASS
	select PM_GENERIC_DOMAINS if PM
	select PM_GENERIC_DOMAINS_OF if PM && OF
	select RISCV_SBI_CPUIDLE if CPU_IDLE && RISCV_SBI
	help
	  This enables support for QEMU Virt Machine.

config ARCH_CANAAN
	bool "Canaan Kendryte SoC"
	help
	  This enables support for Canaan Kendryte series SoC platform hardware.

config SOC_CANAAN_K210
	bool "Canaan Kendryte K210 SoC"
	depends on !MMU && ARCH_CANAAN
	select ARCH_HAS_RESET_CONTROLLER
	select PINCTRL
	select COMMON_CLK
	help
	  This enables support for Canaan Kendryte K210 SoC platform hardware.

endmenu # "SoC selection"
```

## drivers/clk/cvitek/Kconfig
```kconfig
config COMMON_CLK_CVITEK
	bool "Clock driver for CVITEK SoC Family"
	depends on COMMON_CLK
	help
	  Support the clocks on CVITEK CV181x SoC (SG2002).
```

## drivers/media/platform/sophgo/Kconfig
```kconfig
# SPDX-License-Identifier: GPL-2.0-only
config VIDEO_SOPHGO_VDEC
	tristate "Sophgo SG2002 stateful video decoder interface"
	depends on V4L_MEM2MEM_DRIVERS && VIDEO_DEV
	depends on RISCV || COMPILE_TEST
	select VIDEOBUF2_VMALLOC
	select V4L2_MEM2MEM_DEV
	select V4L2_JPEG_HELPER
	help
	  V4L2 memory-to-memory decoding interface for SG2002. A hardware
	  backend registers the codec operations with this driver. The
	  SG2002 vendor codec driver supplies H.264 and baseline JPEG decode
	  operations; capture and encoding remain separate interfaces.

	  To compile this driver as a module, choose M here: the module
	  will be called sophgo-vdec.
```

## drivers/pinctrl/cvitek/Kconfig
```kconfig
config CVITEK_PINCTRL_CV1835
	bool "Cvitek CV181x pinctrl MMIO map"
	depends on PINCTRL
	select PINMUX
	select PINCONF
	select GENERIC_PINCONF
	help
	  Same Kconfig name as Cube 5.10. Maps pinmux MMIO for DT
	  compatibility. Probe does not rewrite pinmux; do not use this
	  to change Cube AUD pins.
```

## drivers/soc/cvitek/Kconfig
```kconfig
#
# CVITEK SoC drivers
#
menu "CVITEK SoC drivers"

config CV1835_SYSDMA_REMAP
	bool "CVITEK SoC sysdma remap driver"
	help
	  Enables driver for sysdma remap on CV1835 / CV181x (SG2002).
	  If someone need to use sysDMA, they need to set src select
	  value of related devices in this top register.

config CVI_WIFI_PIN
	bool "CVITEK SoC wifi specific pin definition"
	help
	  Enables driver for wifi specify pin on CviTek SoC.
	  Enable this configuration to enable API to get
	  GPIO number to do certain action, ex. power on
	  or wakeup pin.

config CVI_BT_PIN
	bool "CVITEK SoC BT specific pin definition"
	help
	  Enables driver for BT specify pin on CviTek SoC.
	  Enable this configuration to enable API to get
	  GPIO number to do certain action, ex. power on
	  or wakeup pin.

endmenu
```
